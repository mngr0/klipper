## src/atsame/Kconfig
```kconfig
# Kconfig settings for Atmel SAME5x processors

if MACH_ATSAME

config ATSAME_SELECT
    bool
    default y
    select HAVE_GPIO
    select HAVE_GPIO_ADC
    select HAVE_GPIO_I2C
    select HAVE_GPIO_SPI
    select HAVE_GPIO_HARD_PWM if MACH_SAMD21
    select HAVE_GPIO_BITBANGING
    select HAVE_STRICT_TIMING
    select HAVE_CHIPID

config BOARD_DIRECTORY
    string
    default "atsame"

choice
    prompt "Processor model"
    config MACH_SAME51
        bool "SAME51G18 (BMI custom board)"
        select SAME51G18
    config MACH_SAME54
        bool "SAME54P20A (XPLAINED-PRO)"
        select SAME54P20A
endchoice


config MCU
    string
    default "same51g18a" if MACH_SAME51
    default "same54p20a" if MACH_SAME54

config FLASH_SIZE
    hex
    default 0x40000 if MACH_ATSAME 


config RAM_START
    hex
    default 0x20000000

config RAM_SIZE
    hex
    default 0x20000 if MACH_ATSAME 


config STACK_SIZE
    int
    default 512

choice
    prompt "Clock Reference"
    config CLOCK_REF_INTERNAL
        bool "Internal clock"
endchoice

choice
    depends on MACH_ATSAME && LOW_LEVEL_OPTIONS
    prompt "Processor speed"
    config SAME5_FREQ_120
        bool "120 MHz (standard)"
    config SAME5_FREQ_150
        bool "150 MHz (overclock)"
    config SAME5_FREQ_180
        bool "180 MHz (overclock)"
    config SAME5_FREQ_200
        bool "200 MHz (overclock)"
endchoice

config CLOCK_FREQ
    int
    default 150000000 if SAME5_FREQ_150
    default 180000000 if SAME5_FREQ_180
    default 200000000 if SAME5_FREQ_200
    default 120000000 if MACH_ATSAME

choice
    prompt "Bootloader offset"
    config FLASH_START_4000
        bool "16KiB bootloader (Arduino M0)"
    config FLASH_START_0000
        bool "No bootloader"
endchoice

config FLASH_START
    hex
    default 0x4000 if FLASH_START_4000
    default 0x2000 if FLASH_START_2000
    default 0x0000

config USBSERIAL
    bool "Use USB for communication (instead of serial)" if MACH_ATSAME
    default y
config SERIAL
    depends on !USBSERIAL
    bool
    default y
config HAVE_SERCOM
    depends on HAVE_GPIO_I2C || HAVE_GPIO_SPI
    bool
    default y

endif
```
